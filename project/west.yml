## project/west.yml
```yaml
manifest:
    
  remotes:
    - name: alif
      url-base: https://github.com/alifsemi
    - name: armmbed
      url-base: https://github.com/ARMmbed

  projects:
    - name: zephyr
      remote: alif
      repo-path: zephyr_alif_2.0
      revision: main
      import:
        # By using name-allowlist we can clone only the modules that are
        # strictly needed by the application.
        name-allowlist:
          - segger       
          - liblc3
          - hal_alif_2.0    # required by the Alif based boards
          - net-tools   # Alif based boards network util tools
          - hal_ethos_u # required by the Alif based boards for npu

    - name: mcuboot_alif
      remote: alif
      repo-path: mcuboot_alif
      path: bootloader/mcuboot
      revision: main

    - name: cmsis_alif
      remote: alif
      revision: main
      path: modules/hal/cmsis
      groups:
         - hal
  self:
    path: alif
    west-commands: scripts/west-commands.yml
```
